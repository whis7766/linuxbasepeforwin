## buildroot-external/Config.in
```kconfig
source "$BR2_EXTERNAL_LINUXBASEPE_PATH/package/lbpe-gui/Config.in"
source "$BR2_EXTERNAL_LINUXBASEPE_PATH/package/wimlib/Config.in"
source "$BR2_EXTERNAL_LINUXBASEPE_PATH/package/hivex/Config.in"
```

## buildroot-external/package/hivex/Config.in
```kconfig
config BR2_PACKAGE_HIVEX
	bool "hivex"
	select BR2_PACKAGE_LIBXML2
	help
	  Library for reading and writing Windows Registry hive files
	  (used for BCD editing). Provides libhivex.

	  https://libguestfs.org/hivex/
```

## buildroot-external/package/lbpe-gui/Config.in
```kconfig
config BR2_PACKAGE_LBPE_GUI
	bool "lbpe-gui"
	depends on BR2_PACKAGE_QT6BASE
	select BR2_PACKAGE_QT6BASE_GUI
	select BR2_PACKAGE_QT6BASE_WIDGETS
	help
	  linuxbasepeforwin integrated Qt6 maintenance GUI.
```

## buildroot-external/package/libbde/Config.in
```kconfig
config BR2_PACKAGE_LIBBDE
	bool "libbde (BitLocker Drive Encryption)"
	depends on BR2_TOOLCHAIN_HAS_THREADS
	select BR2_PACKAGE_LIBOPENSSL
	help
	  Library to access BitLocker Drive Encryption (BDE) volumes.
	  Supports recovery password / password protected volumes and
	  decrypting volume data through libbde_volume_read_buffer().

	  https://github.com/libyal/libbde
```

## buildroot-external/package/wimlib/Config.in
```kconfig
config BR2_PACKAGE_WIMLIB
	bool "wimlib"
	select BR2_PACKAGE_LIBXML2
	select BR2_PACKAGE_OPENSSL
	select BR2_PACKAGE_NTFS_3G
	help
	  Library and tools for creating, extracting, and modifying
	  Windows Imaging (WIM) archives. Provides wimlib-imagex.

	  https://wimlib.net/
```
